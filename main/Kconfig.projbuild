## main/Kconfig.projbuild
```kconfig
menu "Wi-Fi SoftAP Configuration"
    config ESP_WIFI_SSID
        string "Wi-Fi SSID"
        default "ESP32_S3_Display"
        help
            Имя сети (SSID), которую будет создавать точка доступа.

    config ESP_WIFI_PASSWORD
        string "Wi-Fi Password"
        default "12345678"
        help
            Пароль для доступа к сети. Оставьте пустым для открытой сети.

    config ESP_WIFI_CHANNEL
        int "Wi-Fi Channel"
        range 1 11
        default 6
        help
            Номер канала Wi-Fi (1-11). По умолчанию 6.

    config ESP_MAX_STA_CONN
        int "Maximum STA connections"
        range 1 10
        default 4
        help
            Максимальное количество одновременно подключённых клиентов (1-10).
endmenu

menu "Wi-Fi Client (STA) Settings"
    config WIFI_STA_ENABLE
        bool "Enable Wi-Fi Station (client) mode"
        default n
        help
            If enabled, ESP32 will connect to an external Wi-Fi network
            as a station. SSID and password are configured below.

    config WIFI_STA_SSID
        string "Wi-Fi SSID"
        depends on WIFI_STA_ENABLE
        default "myssid"
        help
            SSID of the external Wi-Fi network.

    config WIFI_STA_PASSWORD
        string "Wi-Fi Password"
        depends on WIFI_STA_ENABLE
        default "mypassword"
        help
            Password of the external Wi-Fi network.

    config NTP_SERVER
        string "NTP Server"
        depends on WIFI_STA_ENABLE
        default "pool.ntp.org"
        help
            NTP server to sync time after STA connection.

    config TIMEZONE_OFFSET
        int "Timezone offset (hours from UTC)"
        depends on WIFI_STA_ENABLE
        default 3
        range -12 14
        help
            Offset in hours from UTC (e.g., Moscow is +3).
endmenu

menu "Backlight Settings"
    config BACKLIGHT_TIMEOUT_SEC
        int "Backlight timeout (seconds)"
        default 30
        range 1 3600
        help
            Time of inactivity after which backlight turns off.
            Set to 0 to disable auto-off (not recommended).
endmenu
```

## sdkconfig.defaults
```kconfig
CONFIG_ESP32S3_SPIRAM_SUPPORT=y
CONFIG_SPIRAM_MODE_OCT=y
CONFIG_SPIRAM_USE_CAPS_ALLOC=y
CONFIG_SPIRAM_BOOT_INIT=y
CONFIG_LV_USE_FONT_MONTSERRAT_20=y
CONFIG_LV_USE_FONT_MONTSERRAT_32=y
CONFIG_LV_MEM_SIZE=65536
CONFIG_ESP_TASK_WDT=n
CONFIG_I2C_MASTER=y
CONFIG_I2C_SUPPRESS_DEPRECATE_WARN=y
# Настройки LVGL не требуют indev, так как опрос ручной
```
